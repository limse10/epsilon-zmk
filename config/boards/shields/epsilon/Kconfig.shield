## config/boards/shields/epsilon/Kconfig.shield
```kconfig
# Copyright (c) 2020 The ZMK Contributors
# SPDX-License-Identifier: MIT

config SHIELD_EPSILON_LEFT
	def_bool $(shields_list_contains,epsilon_left)

config SHIELD_EPSILON_RIGHT
	def_bool $(shields_list_contains,epsilon_right)
```

## config/boards/shields/flipper/Kconfig.defconfig
```kconfig
# Copyright (c) 2020 The ZMK Contributors
# SPDX-License-Identifier: MIT

if SHIELD_EPSILON_LEFT

config ZMK_KEYBOARD_NAME
	default "shaoboi.epsilon"

config ZMK_SPLIT_BLE_ROLE_CENTRAL
	default y

endif

if SHIELD_EPSILON_LEFT || SHIELD_EPSILON_RIGHT

config ZMK_SPLIT
	default y

endif
```
